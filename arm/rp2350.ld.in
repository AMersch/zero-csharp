/* The Raspberry Pi Pico 2 itself (RP2350): 4 MB of flash, read in place at
   0x10000000, and 520 KB of RAM at 0x20000000 (SRAM0-7, then SRAM8 and 9,
   one after the other). The first 1 KB of flash holds the vector table and
   the block that tells the boot ROM this is an Arm program (arm/rp2350.S). */
__boot_flash = 0x10000000;
__boot_flash_size = 0x400;
__flash = 0x10000400;
__flash_size = 0x3ffc00;
__ram = 0x20000000;
__ram_size = 0x82000;
__stack_size = 0x4000;

INCLUDE LIBC_LD_FILE
